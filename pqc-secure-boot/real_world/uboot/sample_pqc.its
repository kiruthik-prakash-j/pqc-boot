## pqc-secure-boot/real_world/uboot/sample_pqc.its
```
/dts-v1/;

/ {
    description = "Post-Quantum Cryptography Secure FIT Image";
    #address-cells = <1>;

    images {
        kernel-1 {
            description = "RISC-V 64 Post-Quantum Authenticated Kernel";
            data = /incbin/("test_payload.bin");
            type = "kernel";
            arch = "riscv";
            os = "linux";
            compression = "none";
            load = <0x80200000>;
            entry = <0x80200000>;

            hash-1 {
                algo = "sha256";
            };

            signature-1 {
                algo = "sha256,ml-dsa-44";
                key-name-hint = "dev";
            };

            signature-2 {
                algo = "sha256,sphincs-plus";
                key-name-hint = "dev";
            };

            signature-3 {
                algo = "sha256,lms";
                key-name-hint = "dev";
            };
        };
    };

    configurations {
        default = "config-1";
        config-1 {
            description = "QEMU RISC-V 64 virt PQC Boot Configuration";
            kernel = "kernel-1";

            signature-1 {
                algo = "sha256,ml-dsa-44";
                key-name-hint = "dev";
                sign-images = "kernel";
            };
        };
    };
};
```
